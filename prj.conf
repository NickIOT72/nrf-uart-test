## prj.conf
```kconfig
# nothing here
CONFIG_GPIO=y
# STEP 2 - Enable the serial driver in asynchronous mode
CONFIG_SERIAL=y
CONFIG_UART_ASYNC_API=y
CONFIG_LOG=y
CONFIG_LOG_BACKEND_SHOW_COLOR=y
```

## src/main.c
```c
/*
 * Copyright (c) 2016 Intel Corporation
 *
 * SPDX-License-Identifier: Apache-2.0
 * Note:
 * Tested on nRF Connect SDK Version : 2.0
 */

/* Controlling LEDs through UART. Press 1-3 on your keyboard to toggle LEDS 1-3 on your development kit */

#include <zephyr.h>
#include <drivers/gpio.h>
#include <devicetree.h>
#include <drivers/gpio.h>
#include <sys/printk.h>

/* STEP 3 - Include the header file of the UART driver in main.c */
#include <drivers/uart.h>

/* 1000 msec = 1 sec */
#define SLEEP_TIME_MS 1000

/* STEP 10.1.1 - Define the size of the receive buffer */
#define RECEIVE_BUFF_SIZE 10

/* STEP 10.2 - Define the receiving timeout period */
#define RECEIVE_TIMEOUT 100
#define SLEEP_RECEIVE 25

/* STEP 5.1 - Get the device pointers of the LEDs through gpio_dt_spec */
static const struct gpio_dt_spec led0 = GPIO_DT_SPEC_GET(DT_ALIAS(led0), gpios);
static const struct gpio_dt_spec led1 = GPIO_DT_SPEC_GET(DT_ALIAS(led1), gpios);
static const struct gpio_dt_spec led2 = GPIO_DT_SPEC_GET(DT_ALIAS(led2), gpios);

/* STEP 4.1 - Get the device pointer of the UART hardware */
const struct device *uart = DEVICE_DT_GET(DT_NODELABEL(uart0));

/* STEP 9.1 - Define the transmission buffer, which is a buffer to hold the data to be sent over UART */
static uint8_t tx_buf[] = {"nRF Connect SDK Fundamentals Course\n\r"
						   "Press 1-3 on your keyboard to toggle LEDS 1-3 on your development kit\n\r"};

/* STEP 10.1.2 - Define the receive buffer */
static uint8_t rx_buf[RECEIVE_BUFF_SIZE] = {0};

struct uart_data_t
{
	void *fifo_reserved;
	uint8_t data[RECEIVE_BUFF_SIZE];
	uint16_t len;
};

char BUFFER_RX[RECEIVE_BUFF_SIZE];
bool condUart = false;
int lastlen = 0;

/* STEP 7 - Define the callback function for UART */
static void uart_cb(const struct device *dev, struct uart_event *evt, void *user_data)
{
	struct uart_data_t *buf;

	switch (evt->type)
	{
	case UART_RX_RDY:
		k_msleep(SLEEP_RECEIVE);
		buf = CONTAINER_OF(evt->data.rx.buf, struct uart_data_t, data);
		buf->len = evt->data.rx.len;

		if (lastlen == 0)//
		{
			for (int i = 0; i < RECEIVE_BUFF_SIZE; i++)
			{
				BUFFER_RX[i] = 0;
			}
		}

		int lastpos = (evt->data.rx.offset - buf->len + 1) % RECEIVE_BUFF_SIZE;
		if (lastpos < 0)
		{
			while (lastpos < 0)
			{
				lastpos += RECEIVE_BUFF_SIZE;
			}
		}
		printk("(data: %2d,len: %2d, %2d, %2d, %2d)UART RECEIVED: ", lastlen, buf->len, lastpos, evt->data.rx.offset, evt->data.rx.len);
		int counttt = 0;
		if (lastlen < RECEIVE_BUFF_SIZE)
		{
			for (int i = lastlen; i < lastlen + buf->len; i++)
			{
				char charRead = buf->data[(i + lastpos) % RECEIVE_BUFF_SIZE];
				if (charRead == '1' || charRead == '2' || charRead == '3')
				{
					BUFFER_RX[lastlen + counttt] = charRead;
					printk("%c", charRead);
					counttt += 1;
				}

				if (lastlen + counttt >= RECEIVE_BUFF_SIZE)
				{
					break;
				}
				/*if (evt->data.rx.buf[evt->data.rx.offset] == '1')
					gpio_pin_toggle_dt(&led0);
				else if (evt->data.rx.buf[evt->data.rx.offset] == '2')
					gpio_pin_toggle_dt(&led1);
				else if (evt->data.rx.buf[evt->data.rx.offset] == '3')
					gpio_pin_toggle_dt(&led2);*/
			}
		}

		printk("\r\n");
		condUart = true;
		lastlen += counttt;
		/*if ((evt->data.rx.len) == 1)
		{
			if (evt->data.rx.buf[evt->data.rx.offset] == '1')
				gpio_pin_toggle_dt(&led0);
			else if (evt->data.rx.buf[evt->data.rx.offset] == '2')
				gpio_pin_toggle_dt(&led1);
			else if (evt->data.rx.buf[evt->data.rx.offset] == '3')
				gpio_pin_toggle_dt(&led2);
		}*/
		break;
	case UART_RX_DISABLED:
		uart_rx_enable(dev, rx_buf, sizeof rx_buf, RECEIVE_TIMEOUT);
		break;
	default:
		break;
	}
}

int main(void)
{
	int ret;

	/* STEP 4.2 - Verify that the UART device is ready */
	if (!device_is_ready(uart))
	{
		printk("UART device not ready\r\n");
		return 1;
	}
	/* STEP 5.2 - Verify that the LED devices are ready */
	if (!device_is_ready(led0.port))
	{
		printk("GPIO device is not ready\r\n");
		return 1;
	}
	/* STEP 6 - Configure the GPIOs of the LEDs */
	ret = gpio_pin_configure_dt(&led0, GPIO_OUTPUT_ACTIVE);
	if (ret < 0)
	{
		return 1;
	}
	ret = gpio_pin_configure_dt(&led1, GPIO_OUTPUT_ACTIVE);
	if (ret < 0)
	{
		return 1;
	}
	ret = gpio_pin_configure_dt(&led2, GPIO_OUTPUT_ACTIVE);
	if (ret < 0)
	{
		return 1;
	}
	/* STEP 8 - Register the UART callback function */
	ret = uart_callback_set(uart, uart_cb, NULL);
	if (ret)
	{
		return 1;
	}
	/* STEP 9.2 - Send the data over UART by calling uart_tx() */
	ret = uart_tx(uart, tx_buf, sizeof(tx_buf), SYS_FOREVER_US);
	if (ret)
	{
		return 1;
	}
	/* STEP 10.3  - Start receiving by calling uart_rx_enable() and pass it the address of the receive  buffer */
	ret = uart_rx_enable(uart, rx_buf, sizeof rx_buf, RECEIVE_TIMEOUT);
	if (ret)
	{
		return 1;
	}
	while (1)
	{
		k_msleep(SLEEP_TIME_MS);
		if (condUart)
		{
			for (int j = 0; j < 10; j++)
			{
				if (BUFFER_RX[j] == '1')
				{
					gpio_pin_toggle_dt(&led0);
					k_msleep(SLEEP_TIME_MS);
				}
				else if (BUFFER_RX[j] == '2')
				{
					gpio_pin_toggle_dt(&led1);
					k_msleep(SLEEP_TIME_MS);
				}
				else if (BUFFER_RX[j] == '3')
				{
					gpio_pin_toggle_dt(&led2);
					k_msleep(SLEEP_TIME_MS);
				}
			}
			condUart = false;
			lastlen = 0;
		}
	}
}
```
